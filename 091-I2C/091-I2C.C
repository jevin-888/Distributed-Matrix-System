#include<REG51.H>
//=============== 端口定义 ===============
sbit SCL = P3^1;
sbit SDA = P3^2;
sbit RES = P3^3;
//=============== 函数声明 ==================
void SSD1306();
void I2C_O(unsigned char mcmd);
void I2C_Ack();
void I2C_Start();
void I2C_Stop();
void writec(unsigned char COM);
void writed(unsigned char DATA);
void delay(unsigned int tt);
void fill(unsigned char dat1, unsigned char dat2);
void showChar(unsigned char page, unsigned char col, unsigned char c);
void showStr(unsigned char page, unsigned char col, unsigned char *s);
void uart_init();
unsigned char uart_getchar();
void uart_gets(unsigned char *buf, unsigned char maxlen);

// 系统名称（可通过 UART 更新，初始默认值）
unsigned char sys_name[21] = "DMS-Node";
// IP 地址（通过 UART 接收，格式 "xxx.xxx.xxx.xxx"）
unsigned char sys_ip[17]   = "192.168.1.1";

//=======================================================
// 6x8 ASCII 字体 (0x20~0x7E)，每字符 6 字节列数据，MSB=顶部
//=======================================================
unsigned char code font6x8[][6] = {
    {0x00,0x00,0x00,0x00,0x00,0x00}, // 0x20 space
    {0x00,0x00,0x5F,0x00,0x00,0x00}, // !
    {0x00,0x07,0x00,0x07,0x00,0x00}, // "
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    {0x08,0x04,0x08,0x10,0x08,0x00}, // ~
};

//=======================================================
main()
{
    unsigned char cmd[24];
    unsigned char i;

    RES=1; delay(1000);
    RES=0; delay(1000);
    RES=1; delay(1000);
    SSD1306();
    uart_init();

    fill(0x00,0x00);
    showStr(0, 0, sys_name);
    showStr(2, 0, sys_ip);

    while(1)
    {
        // 等待 UART 命令，格式:
        //   NAME=<hostname>\n  — 更新系统名称
        //   IP=<address>\n     — 更新 IP 地址
        uart_gets(cmd, sizeof(cmd));

        if (cmd[0]=='N' && cmd[1]=='A' && cmd[2]=='M' && cmd[3]=='E' && cmd[4]=='=') {
            for (i=0; i<20 && cmd[5+i]!='\0'; i++)
                sys_name[i] = cmd[5+i];
            sys_name[i] = '\0';
        } else if (cmd[0]=='I' && cmd[1]=='P' && cmd[2]=='=') {
            for (i=0; i<16 && cmd[3+i]!='\0'; i++)
                sys_ip[i] = cmd[3+i];
            sys_ip[i] = '\0';
        }

        fill(0x00,0x00);
        showStr(0, 0, sys_name);
        showStr(2, 0, sys_ip);
    }
}

//=======================================================
void I2C_O(unsigned char mcmd)
{
    unsigned char length = 8;
    while(length--)
    {
        SDA = (mcmd & 0x80) ? 1 : 0;
        SCL=1;
        SCL=0;
        mcmd = mcmd << 1;
    }
}

void I2C_Ack()
{
    SDA=1; SCL=1; SCL=0;
}

void I2C_Start()
{
    SDA=0; SCL=1; SCL=0;
    I2C_O(0x78);   // SSD1306 I2C 地址 0x3C << 1
    I2C_Ack();
}

void I2C_Stop()
{
    SCL=1; SDA=0; SDA=1;
}

void writec(unsigned char COM)
{
    I2C_Start();
    I2C_O(0x00);   // Co=0, D/C#=0 -> command
    I2C_Ack();
    I2C_O(COM);
    I2C_Ack();
    I2C_Stop();
}

void writed(unsigned char DATA)
{
    I2C_Start();
    I2C_O(0x40);   // Co=0, D/C#=1 -> data
    I2C_Ack();
    I2C_O(DATA);
    I2C_Ack();
    I2C_Stop();
}

void delay(unsigned int i)
{
    while(i>0) { i--; }
}

//=======================================================
void SSD1306()
{
    writec(0xAE);           // display off
    writec(0xD5); writec(0x80); // clock div
    writec(0xA8); writec(0x3F); // multiplex 64
    writec(0xD3); writec(0x00); // display offset
    writec(0x40);           // start line 0
    writec(0x8D); writec(0x14); // charge pump on
    writec(0x20); writec(0x00); // horizontal addr mode
    writec(0xA1);           // segment remap
    writec(0xC8);           // COM scan direction
    writec(0xDA); writec(0x12); // COM pins
    writec(0x81); writec(0xCF); // contrast
    writec(0xD9); writec(0xF1); // pre-charge
    writec(0xDB); writec(0x40); // VCOMH
    writec(0xA4);           // display from RAM
    writec(0xA6);           // normal display
    writec(0xAF);           // display on
}

//=======================================================
void fill(unsigned char dat1, unsigned char dat2)
{
    unsigned char i, j;
    for (j=0; j<8; j++) {
        writec(0xB0+j);     // page address
        writec(0x00);       // col low
        writec(0x10);       // col high
        for (i=0; i<64; i++) {
            writed(dat1);
            writed(dat2);
        }
    }
}

//=======================================================
// 在指定 page、列 col 显示一个 ASCII 字符 (6x8 像素)
void showChar(unsigned char page, unsigned char col, unsigned char c)
{
    unsigned char i;
    unsigned char idx;
    if (c < 0x20 || c > 0x7E) c = 0x20;
    idx = c - 0x20;
    writec(0xB0 | (page & 0x07));
    writec(0x00 | (col & 0x0F));
    writec(0x10 | ((col >> 4) & 0x0F));
    for (i=0; i<6; i++)
        writed(font6x8[idx][i]);
}

//=======================================================
// 在指定 page、起始列 col 显示字符串（每行最多 21 字符）
void showStr(unsigned char page, unsigned char col, unsigned char *s)
{
    while (*s && col < 128) {
        showChar(page, col, *s);
        col += 6;
        s++;
    }
}

//=======================================================
// UART 初始化：11.0592MHz 晶振，波特率 9600
void uart_init()
{
    SCON = 0x50;    // 串口模式1，允许接收
    TMOD |= 0x20;   // T1 模式2（自动重载）
    TH1  = 0xFD;    // 9600 baud @ 11.0592MHz
    TL1  = 0xFD;
    TR1  = 1;       // 启动 T1
}

unsigned char uart_getchar()
{
    while (!RI);    // 等待接收完成
    RI = 0;
    return SBUF;
}

// 读取一行（以 '\n' 结尾），去掉 '\r'，null 终止
void uart_gets(unsigned char *buf, unsigned char maxlen)
{
    unsigned char i = 0;
    unsigned char c;
    while (i < maxlen - 1) {
        c = uart_getchar();
        if (c == '\n') break;
        if (c == '\r') continue;
        buf[i++] = c;
    }
    buf[i] = '\0';
}
